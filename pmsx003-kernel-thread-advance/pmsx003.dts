/dts-v1/;

/ {
    #address-cells = <1>;
    #size-cells = <1>;

    pmsx003 {
        compatible = "plantower,pmsx003";
        reg = <0xFF200000 0x1000>;
        pinctrl-names = "default";
        pinctrl-0 = <&pmsx003_pins>;
        reset-gpios = <&gpio 17 GPIO_ACTIVE_HIGH>;
        set-gpios = <&gpio 27 GPIO_ACTIVE_HIGH>;
        uart = <&uart0>;
        status = "okay";
        interrupt-parent = <&gpio>;
        interrupts = <18 IRQ_TYPE_EDGE_RISING>;
        power-domains = <&power_domain>;
        clocks = <&clk_uart>;
    };
};